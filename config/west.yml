## config/west.yml
```yaml
manifest:
  remotes:
    - name: zmkfirmware
      url-base: https://github.com/zmkfirmware
    - name: caksoylar  # <-- new entry
      url-base: https://github.com/caksoylar
    - name: kzyz  # <-- az1uball driver
      url-base: https://github.com/kzyz
  projects:
    - name: zmk
      remote: zmkfirmware
      revision: v0.3
      import: app/west.yml
    - name: zmk-rgbled-widget  # <-- new entry
      remote: caksoylar
      revision: v0.3
    - name: zmk_az1uball_driver
      remote: kzyz
      revision: main
  self:
    path: config
```
