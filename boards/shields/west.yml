## boards/shields/west.yml
```yaml
manifest:
  remotes:
    - name: zmkfirmware
      url-base: https://github.com/zmkfirmware
    - name: sayu-hub
      url-base: https://github.com/sayu-hub
    - name: caksoylar  # <-- new entry
      url-base: https://github.com/caksoylar
    - name: kzyz  # <-- az1uball driver
      url-base: https://github.com/kzyz

  projects:
    - name: zmk
      remote: zmkfirmware
      revision: main
      import: app/west.yml
    - name: zmk-pmw3610-driver
      remote: sayu-hub
      revision: main
    - name: zmk-rgbled-widget  # <-- new entry
      remote: caksoylar
      revision: main
    - name: zmk-az1uball-driver
      remote: kzyz
      revision: main
  self:
    path: config
```

## config/boards/shields/ChocX/Kconfig.defconfig
```kconfig
if SHIELD_CHOCX_R

config ZMK_KEYBOARD_NAME
    default "ChocX_R"

config ZMK_SPLIT
    default y

config ZMK_SPLIT_ROLE_CENTRAL
    default y

config ZMK_POINTING
    default y

config AZ1UBALL
    default y

config I2C
    default y

config SPI
    default y

endif


if SHIELD_CHOCX_R || SHIELD_CHOCX_L

config ZMK_SPLIT
    default y

config SPI
    default y

endif     # SHIELD_CHOCX_R || SHIELD_CHOCX_L
```

## config/boards/shields/ChocX/Kconfig.shield
```kconfig
config SHIELD_CHOCX_R
    def_bool $(shields_list_contains,ChocX_R)

config SHIELD_CHOCX_L
    def_bool $(shields_list_contains,ChocX_L)
```
